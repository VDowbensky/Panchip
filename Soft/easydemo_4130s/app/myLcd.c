#include <stdlib.h>
#include <stdio.h>
#include <stdbool.h>
#include <stdarg.h>
#include <string.h>
#include <math.h>
#include "myLcd.h"
#include "board.h"

#define LCD_DEVICE_ADDR 0x78
#define SENSOR_DEVICE_ADDR 0x44<<1
static uint8_t commandType = 0;

static uint8_t const Chinese_text_16x16[]=
{
"深圳市沃进科技有限公司→←↑↓¤"
};
static uint8_t const Chinese_code_16x16[]=
{
0x08,0x06,0x40,0x31,0x00,0x70,0x44,0x48,0x50,0x43,0x50,0x48,0x44,0x70,0x00,0x00,
0x20,0x20,0x7E,0x80,0x04,0x84,0x88,0x90,0xA0,0xFF,0xA0,0x90,0x88,0x84,0x04,0x00,/*"深",0*/

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0x00,0x02,0x04,0xE8,0x10,0x08,0x08,0x08,0x08,0x08,0x08,0x10,0xE8,0x04,0x02,0x00,/*"¤",15*/
};

const uint8_t ascii_table_8x16[95][16]=
{
0x00,0x00,0x00,0x00,0x00,0x00,0x00,0x00,0x00,0x00,0x00,0x00,0x00,0x00,0x00,0x00,/*" ",0*/

0x00,0x00,0x00,0x1F,0x00,0x00,0x00,0x00,0x00,0x00,0x00,0xCC,0x00,0x00,0x00,0x00,/*"!",1*/
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0x00,0x40,0x80,0x40,0x40,0x20,0x40,0x00,0x00,0x00,0x00,0x00,0x00,0x00,0x00,0x00,/*"~",94*/
};
uint8_t const number_table_8x16[]=
{
  0xF8,0xF8,0x0C,0xC4, 0x0C,0xF8,0xF0,0x00, 0x03,0x07,0x0C,0x08, 0x0C,0x07,0x03,0x00, //-0- ASCII:0X30
  0x00,0x10,0x18,0xFC, 0xFC,0x00,0x00,0x00, 0x00,0x08,0x08,0x0F, 0x0F,0x08,0x08,0x00, //-1-
  0x08,0x0C,0x84,0xC4, 0x64,0x3C,0x18,0x00, 0x0E,0x0F,0x09,0x08, 0x08,0x0C,0x0C,0x00, //-2-
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  0x38,0x7C,0x44,0x44, 0x44,0xFC,0xF8,0x00, 0x00,0x08,0x08,0x08, 0x0C,0x07,0x03,0x00, //-9-
};
uint8_t const vollgoLogo94_68[]=
{
0x00,0x00,0x00,0x00,0x00,0x00,0x00,0x00,0x00,0x00,0x00,0x00,0x00,0x00,0x00,0x00,
0x00,0x00,0x00,0x00,0x00,0x00,0x00,0x00,0x00,0x00,0x00,0x00,0x00,0x00,0x00,0x00,
0x00,0x00,0x00,0x00,0x00,0x00,0x00,0x00,0x00,0x0F,0x1F,0x3F,0x7F,0x7F,0x7F,0xFF,
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0x00,0x00,0x00,0x00,0x00,0x00,0x00,0x00,0x00,0x00,0x00,0x00,0x00,0x00
};
imageParams_ts imageParams[5];
static void myLCD_delay(uint32_t time_us)
{
  uint16_t i = 0;
  uint32_t j = 0;
  for ( j = 0; j < time_us; j++)
  {
    for (i = 0; i < 10; i++)
    {
      ;
    }
  }
}
static void myLCD_start_flag(void)
{
  LCD_CLK_H(); /*START FLAG*/
  LCD_SDA_H(); /*START FLAG*/
  LCD_SDA_L(); /*START FLAG*/
}
static void myLCD_stop_flag(void)
{
  LCD_CLK_H(); /*STOP FLAG*/
  LCD_SDA_L(); /*STOP FLAG*/
  LCD_SDA_H(); /*STOP FLAG*/
}
static uint8_t i2c_wait_ack(void)
{
    uint8_t timeoutCnt = 0;

    myLCD_setSdaMode(GPIO_Mode_IN_FLOATING);
    LCD_CLK_H();
    while (READ_LCD_SDA()) 
    {
        timeoutCnt++;
        if (timeoutCnt > 250) 
        {
            return 0;
        }
    }
    LCD_CLK_L();

    return 1;
}
static void myLCD_transfer(uint8_t src)
{
  uint8_t i;
//  myLCD_setSdaMode(GPIO_Mode_Out_OD);
  for(i = 0; i < 8;i ++)
  {
    LCD_CLK_L();
    if(src & 0x80)
    {
      LCD_SDA_H();
    }
    else
    {
      LCD_SDA_L();
    }
    LCD_CLK_H();
    LCD_CLK_L();
    src = src << 1;
  }
  LCD_SDA_L();
  LCD_CLK_H();
  LCD_CLK_L();
}
static uint8_t myLCD_receiver(bool ack)
{
  uint8_t i;
  uint8_t ret = 0;
  myLCD_setSdaMode(GPIO_Mode_IN_FLOATING);
  for(i = 0; i < 8;i ++)
  {
    LCD_CLK_L();
    myLCD_delay(3);
    LCD_CLK_H();
    ret = ret << 1;
    if(READ_LCD_SDA())
    {
      ret ++;
    }
    myLCD_delay(3);
  }
  myLCD_setSdaMode(GPIO_Mode_Out_OD);
  LCD_CLK_L();
  myLCD_delay(1);
  if (ack)
  {
      LCD_SDA_L();
  }
  else
  {
      LCD_SDA_H();
  }
  myLCD_delay(1);
  LCD_CLK_H();
  myLCD_delay(4);
  LCD_CLK_L();
  myLCD_delay(1);
  if (ack)
  {
      LCD_SDA_H();
  }
  else
  {
      LCD_SDA_L();
  }
    return ret;
}

static void mySensor_transfer_command(uint16_t cmd)
{
  myLCD_start_flag();
  myLCD_transfer(SENSOR_DEVICE_ADDR);
  myLCD_delay(50);
  myLCD_transfer(cmd >> 8);
  myLCD_delay(50);
  myLCD_transfer(cmd);
  myLCD_stop_flag();
}
static void mySensor_read(uint8_t *readData, uint8_t len)
{
    uint8_t i;
    myLCD_start_flag();
    myLCD_transfer(SENSOR_DEVICE_ADDR | 0x01);
    LCD_SDA_H();
    myLCD_delay(2000);
    for ( i = 0; i < len; i++)
    {
        readData[i] = myLCD_receiver(i==(len - 1)?false:true);
    }
    myLCD_stop_flag();
}
//-----------------------------------------------------------------------------
/**
 * 
 * 兼容SHT3x，SHT2X，HTU2x
*/
static float conversionTemperature(unsigned int rawValue)
{
    // calculate temperature [掳C]
    // T = -45 + 175 * rawValue / (2^16-1)
    return 175.0f * (float)rawValue / 65535.0f - 45.0f;
}
static float conversionRelativeHumidity(unsigned int rawValue)
{
    // calculate relative humidity [%RH]
    // RH = rawValue / (2^16-1) * 100
    return 100.0f * (float)rawValue / 65535.0f;
}
//-----------------------------------------------------------------------------
int SHT3X_getPresentValue(int *pTemp, int *pHumit, unsigned char decimalPlaces)
{
    int retSta = 0; //
    unsigned int rawValueTemp; //
    unsigned int rawValueHumi; //
    uint8_t readTempt[6]; 
    mySensor_transfer_command(0x2C06);
    myLCD_delay(50);
    mySensor_read(readTempt, 6);
    rawValueTemp = (unsigned int)readTempt[0]<<8 | readTempt[1];
    rawValueHumi = (unsigned int)readTempt[3]<<8 | readTempt[4];

    *pTemp = (int)(conversionTemperature(rawValueTemp)*pow(10,decimalPlaces));//& (0x00ff)
    *pHumit = (int)(conversionRelativeHumidity(rawValueHumi)*pow(10,decimalPlaces));
    return retSta;
}
//写命令到液晶显示模块
static void myLCD_transfer_command(uint8_t cmd)
{
  commandType = cmd;
  myLCD_start_flag();
  myLCD_transfer(LCD_DEVICE_ADDR);
  myLCD_transfer(0x80);
  myLCD_transfer(cmd);
  myLCD_stop_flag();
}
//写数据到液晶显示模块
static void myLCD_transfer_data(uint8_t src)
{
  myLCD_start_flag();
  myLCD_transfer(LCD_DEVICE_ADDR);
  myLCD_transfer(0xC0);
  myLCD_transfer(src);
  myLCD_stop_flag();
}
static void myLCD_setCommandType(commandType_te command)
{
  if (commandType != command)
  {
    myLCD_transfer_command(command); 
  }
}
void myLCD_setDisplayOnOff(uint8_t status)
{
  myLCD_setCommandType(CMDT_EXT_CMD1); //
  myLCD_transfer_command(status);
}
void myLCD_diplayMode(displayMode_te mode)
{
  myLCD_setCommandType(CMDT_EXT_CMD1);
  myLCD_transfer_command(LCD_CMD_DISPLAY_MODE); //Display Mode
  myLCD_transfer_data(mode); //10=Monochrome Mode,11=4Gray
}
/**
 * level_b,浅灰度
 * level_d,浅灰度
 * 注意：调用该函数前，需先设置@LCD_CMD_DISPLAY_MODE为@DM_4GRAY_MODE
*/
void myLCD_setGrayLevel(uint8_t level_b, uint8_t level_d)
{
  myLCD_setCommandType(CMDT_EXT_CMD2);
  myLCD_transfer_command(LCD_CMD_SET_GRAY_LEVEL); // Gray Level
  myLCD_transfer_data(0x00);
  myLCD_transfer_data(0x00);
  myLCD_transfer_data(0x00);
  myLCD_transfer_data(level_b & 0x1f); //浅灰度
  myLCD_transfer_data(level_b & 0x1f); //浅灰度
  myLCD_transfer_data(level_b & 0x1f); //浅灰度
  myLCD_transfer_data(0x00);
  myLCD_transfer_data(0x00);
  myLCD_transfer_data(level_d & 0x1f); //深灰度
  myLCD_transfer_data(0x00);
  myLCD_transfer_data(0x00);
  myLCD_transfer_data(level_d & 0x1f); //深灰度
  myLCD_transfer_data(level_d & 0x1f); //深灰度
  myLCD_transfer_data(level_d & 0x1f); //深灰度
  myLCD_transfer_data(0x00);
  myLCD_transfer_data(0x00);
}
#define MAX_LCD_VOP_VALUE 511
void myLCD_setVop(uint16_t value)
{
  value = value & MAX_LCD_VOP_VALUE;
  myLCD_transfer_command(CMDT_EXT_CMD1);
  myLCD_transfer_command(LCD_CMD_SET_VOP); //
  myLCD_transfer_data(value & 0x3f); //
  myLCD_transfer_data((value >> 6) & 0x07); //
}
void myLCD_resetLcd(void)
{
    LCD_RST_ENABLE();
    myLCD_delay(100);
    LCD_RST_DISABLE();
}
/*写 LCD 行列地址：X 为起始的列地址，Y 为起始的行地址，x_total,y_total 分别为列地址及行地址的起点到
终点的差值 */
void myLCD_displayAddress(int x,int y,int x_total,int y_total)
{
  x = x - 1;
  y = y + 7;
  myLCD_setCommandType(CMDT_EXT_CMD1);
  myLCD_transfer_command(LCD_CMD_CLUMN_ADDR_SETTING); //Set Column Address
  myLCD_transfer_data(x);
  myLCD_transfer_data(x + x_total - 1);
  myLCD_transfer_command(LCD_CMD_PAGE_ADDR_SETTING); //Set Page Address
  myLCD_transfer_data(y);
  myLCD_transfer_data(y + y_total - 1);
  myLCD_transfer_command(LCD_CMD_WRITE_DISPLAY_DATA);
}
//写入一组 16x16 点阵的汉字字符串（字符串表格中需含有此字）
//括号里的参数：(页，列，汉字字符串）
/**
 * 
 * inverseMode: 
 * column: min=1，max=193
 * page: min=1，max=11
*/
void myLCD_16x16(inverseMode_te inverseMode, uint8_t column, uint8_t page, char *text)
{
  uint16_t i,j,k;
  uint16_t address;
  j=0;
  while(text[j] != '\0')
  {
    i=0;
    address=1;
    while(Chinese_text_16x16[i] > 0x7e)
    {
      if(Chinese_text_16x16[i] == text[j])
      {
        if(Chinese_text_16x16[i+1] == text[j+1])
        {
          address=i*16;
          break;
        }
      }
      i += 2;
    }
    if(address != 1)
    {
      myLCD_displayAddress(column,page,16,2);
      for(k=0;k<2;k++)
      {
        for(i=0;i<16;i++)
        {
          if (inverseMode == IM_INVERSE)
          {
            myLCD_transfer_data(~Chinese_code_16x16[address]);
          }
          else
          {
            myLCD_transfer_data(Chinese_code_16x16[address]);
          }
          address++;
        }
      }
      j +=2;
    }
    else
    {
      myLCD_displayAddress(column,page,16,2);
      for(k=0;k<2;k++)
      {
        for(i=0;i<16;i++)
        {
          if (inverseMode == IM_INVERSE)
          {
            myLCD_transfer_data(0xff);
          }
          else
          {
            myLCD_transfer_data(0x00);
          }
        }
      }
      j++;
    }
    column+=16;
  }
}
/**
 * 
 * column: min=1，max=193
 * page: min=1，max=6
*/
void myLCD_8x16(inverseMode_te inverseMode, int column, int page, char *text)
{
    uint16_t i=0,j,k;
    int pageCount;
    int columnCount;
    
    pageCount = page;
    while(text[i]>0x00)
    { 
        if((text[i]>=0x20)&&(text[i]<=0x7e))
        {
            j = text[i]-0x20;
            myLCD_displayAddress(column, page * 2 - 1, 8, 2);
            columnCount = column;
            pageCount = page;
            for(k=0;k<16;k++)
            {

              if (k == 8)
              {
                pageCount ++;
                columnCount = column;
              }
              columnCount ++;
              if (pageCount > MAX_PAGE_COUNT)
              {
                break;
              }
              if (columnCount > MAX_COLUMN_COUNT)
              {
                break;
              }

              if (inverseMode == IM_INVERSE)
              {
                myLCD_transfer_data(~ascii_table_8x16[j][k]);
              }
              else
              {
                myLCD_transfer_data(ascii_table_8x16[j][k]);
              }
            }
            column += 8;
            if (column > MAX_COLUMN_COUNT)
            {
              break;
            }
        }
        i++;
    }
}
/**
 * 
 * column: min=1，max=193
 * page: min=1，max=11
*/
void myLCD_str8x16(inverseMode_te inverseMode, int column, int page, char *fmt, ...)
{
  va_list va;
  char tempTab[50];
  int len;
  va_start(va, fmt);
  memset(tempTab, 0, sizeof(tempTab));
  vsnprintf(tempTab, (int)sizeof(tempTab), fmt, va);
  len = strlen(tempTab);
  if (len > MAX_COLUMN_COUNT)
  {
    len = MAX_COLUMN_COUNT;
  }
  
  if (column == HORIZONTAL_CENTER)
  {
    len = strlen(tempTab) * 8 / 2;
    column = MAX_COLUMN_COUNT / 2 - len;
  }
  if (column == HORIZONTAL_RIGHT)
  {
    len = strlen(tempTab) * 8;
    column = MAX_COLUMN_COUNT - len;
  }
  if (column == HORIZONTAL_LEFT)
  {
    column = 1;
  }
  
  myLCD_8x16(inverseMode, column, page, tempTab);
  va_end(va);

}

/*显示 32*32 点阵的汉字或等同于 32*32 点阵的图像*/
void myLCD_32x32(inverseMode_te inverseMode, int x,int y,char *dp)
{
  int i,j;
  myLCD_displayAddress(x,y,32,4);
  for(i=0;i<4;i++)
  {
    for(j=0;j<32;j++)
    {
      myLCD_transfer_data(*dp);
      dp++;
    }
  }
}

void myLCD_displayDot(int x, int y)
{
  myLCD_displayAddress(x, y, 0, 0);
  myLCD_transfer_data(0x01);
}
void myLCD_displayImage(inverseMode_te inverseMode, int x, int y, imageSrc_te index)
{
  int j;
  int x_count;
  int y_count;
  x_count = x;
  y_count = y;
  myLCD_displayAddress(x, y, imageParams[index].width, imageParams[index].heigth / 8);
  for(j = 0;j < imageParams[index].width * imageParams[index].heigth / 8;j ++)
  {
    x_count ++;
    if (x_count > MAX_COLUMN_COUNT)
    {
      x_count = x;
      y_count ++;
      continue;
    }
    if (y_count > MAX_PAGE_COUNT)
    {
      break;
    }
    
    if (inverseMode == IM_INVERSE)
    {
      myLCD_transfer_data(~(*imageParams[index].imageSrc));
    }
    else
    {
      myLCD_transfer_data(*imageParams[index].imageSrc);
    }
    imageParams[index].imageSrc++;
  }
}
/**
 * 显示滚动驱动
 * 
 * 注意：未调试
 * 
*/
void myLCD_scroll(scrollDisplayMode_te mode, uint8_t startAddr, uint8_t endAddr, uint8_t pages)
{
  myLCD_setCommandType(CMDT_EXT_CMD1);
  myLCD_transfer_command(LCD_CMD_SCROLL_AREA_DISPLAY); //
  myLCD_transfer_data(startAddr); //
  myLCD_transfer_data(endAddr); //
  myLCD_transfer_data(pages); //
  myLCD_transfer_data(mode); //
}
/**
 * 显示滚动驱动
 * 
 * 注意：未调试
 * 
*/
void myLCD_scrollLine(uint8_t pages)
{
  myLCD_setCommandType(CMDT_EXT_CMD1);
  myLCD_transfer_command(LCD_CMD_SCROLL_AREA_DISPLAY_INIT); //
  myLCD_transfer_data(pages); //
}
void myLCD_clearFull(void)
{
  int i;
  myLCD_displayAddress(1, 1, MAX_COLUMN_COUNT, MAX_PAGE_COUNT);
  for(i = 0; i< MAX_COLUMN_COUNT * MAX_PAGE_COUNT; i++)
  {
    myLCD_transfer_data(0x00);
  }
}
void myLCD_displayBlock(int x,int y)
{
  int i;
  myLCD_displayAddress(x, y, 8, 1);
  for(i = 0; i< 4; i++)
  {
    myLCD_transfer_data(0xff);
  }
}
void test(int x,int y)
{
  int i,j;
  myLCD_setCommandType(CMDT_EXT_CMD1);
  myLCD_displayAddress(x,y,256,16);
  for(i=0;i<16;i++)
  {
    for(j=0;j<255;j++)
    {
      myLCD_transfer_data(0x55);
    }
  }
}

void myLCD_setSdaMode(GPIOMode_TypeDef GPIO_Mode)
{
    static GPIOMode_TypeDef mode;
    GPIO_InitTypeDef  GPIO_InitStructure;
    if (GPIO_Mode == mode)
    {
        return;
    }
    
    GPIO_InitStructure.GPIO_Pin = BOARD_PIN_LCD_SDA;				
    GPIO_InitStructure.GPIO_Mode = GPIO_Mode; 		
    GPIO_InitStructure.GPIO_Speed = GPIO_Speed_50MHz;		 
    GPIO_Init(BOARD_PORT_LCD_SDA, &GPIO_InitStructure);
    mode = GPIO_Mode;
}

void myLCD_init(void)
{
    GPIO_InitTypeDef  GPIO_InitStructure;

    GPIO_InitStructure.GPIO_Pin = BOARD_PIN_LCD_BG_LED;				
    GPIO_InitStructure.GPIO_Mode = GPIO_Mode_Out_PP; 		
    GPIO_InitStructure.GPIO_Speed = GPIO_Speed_50MHz;		 
    GPIO_Init(BOARD_PORT_LCD_BG_LED, &GPIO_InitStructure);

    GPIO_InitStructure.GPIO_Pin = BOARD_PIN_LCD_SDA;				
    GPIO_InitStructure.GPIO_Mode = GPIO_Mode_Out_PP; 		
    GPIO_InitStructure.GPIO_Speed = GPIO_Speed_50MHz;		 
    GPIO_Init(BOARD_PORT_LCD_SDA, &GPIO_InitStructure);
    GPIO_InitStructure.GPIO_Pin = BOARD_PIN_LCD_CLK;				
    GPIO_InitStructure.GPIO_Mode = GPIO_Mode_Out_PP; 		
    GPIO_InitStructure.GPIO_Speed = GPIO_Speed_50MHz;		 
    GPIO_Init(BOARD_PORT_LCD_CLK, &GPIO_InitStructure);
    GPIO_InitStructure.GPIO_Pin = BOARD_PIN_LCD_RST;				
    GPIO_InitStructure.GPIO_Mode = GPIO_Mode_Out_PP; 		
    GPIO_InitStructure.GPIO_Speed = GPIO_Speed_50MHz;		 
    GPIO_Init(BOARD_PORT_LCD_RST, &GPIO_InitStructure);

    LCD_BG_LED_ON();

    LCD_RST_ENABLE();
    myLCD_delay(100);
    LCD_RST_DISABLE();
    myLCD_delay(10000);

		
    myLCD_setCommandType(CMDT_EXT_CMD1);
    myLCD_transfer_command(LCD_CMD_POWER_SAVE_OFF); //Sleep out

    myLCD_setCommandType(CMDT_EXT_CMD2);
    myLCD_transfer_command(0xD7); //Autoread disable
    myLCD_transfer_data(0X9F); //
    myLCD_transfer_command(LCD_CMD_SET_LCD_OFFSET_VOL); //Analog SET
    myLCD_transfer_data(0x00); //OSC Frequency adjustment
    myLCD_transfer_data(0x01); //Frequency on booster capacitors->6KHz
    myLCD_transfer_data(0x03); //Bias=1/11
    // myLCD_setGrayLevel(0x12, 0x17);

    myLCD_setCommandType(CMDT_EXT_CMD1);
    myLCD_transfer_command(LCD_CMD_DATA_FORMAT_D7_D0); //Page Address setting
    myLCD_transfer_command(LCD_CMD_PAGE_ADDR_SETTING); //Page Address setting
    myLCD_transfer_data(0X00); // XS=0
    myLCD_transfer_data(0X14); // XE=159 0x28
    myLCD_transfer_command(LCD_CMD_CLUMN_ADDR_SETTING); //Clumn Address setting
    myLCD_transfer_data(0X00); // XS=0
    myLCD_transfer_data(0Xff); // XE=256
    myLCD_transfer_command(LCD_CMD_SCAN_DIRECTION); //Data scan direction
    myLCD_transfer_data(0x00); //MX.MY=Normal
    myLCD_transfer_data(0xA6);
    myLCD_transfer_command(LCD_CMD_DISPLAY_CONTROL); //Display Control
    myLCD_transfer_data(0X00); //
    myLCD_transfer_data(0X9F); //Duty=160
    myLCD_transfer_data(0X20); //Nline=off
    myLCD_diplayMode(DM_MONO_MODE);
    myLCD_setVop(250);//→←↑↓¤
    myLCD_transfer_command(LCD_CMD_POWER_CONTROL); //Power control
    myLCD_transfer_data(0x0B); //D0=regulator ; D1=follower ; D3=booste, on:1 off:0
    myLCD_delay(10000);
    myLCD_transfer_command(LCD_CMD_DISPLAY_ON); //Display on
    myLCD_delay(10000);
    myLCD_clearFull();

    imageParams[0].imageSrc = (uint8_t *)vollgoLogo94_68;
    imageParams[0].width = 94;
    imageParams[0].heigth = 72;
}
